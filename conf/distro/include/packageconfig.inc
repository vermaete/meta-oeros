## conf/distro/include/packageconfig.inc
```bitbake
# Copyright (c) 2026 Wind River Systems, Inc.

# Adjust PACKAGECONFIG settings
PACKAGECONFIG:append:pn-clang = " libomp"
PACKAGECONFIG:append:pn-qtbase-native = " gui"
PACKAGECONFIG:append:pn-python3 = " tk"
```

## conf/distro/oeros.conf
```bitbake
# Copyright (c) 2026 Wind River Systems, Inc.

# OpenEmbedded ROS (OE ROS) Reference Distribution
DISTRO = "oeros"
DISTRO_NAME = "Oeros (OpenEmbedded ROS Reference Distro)"
DISTRO_VERSION = "2026.04"
DISTRO_CODENAME = "alpha"

MAINTAINER = "Rob Woolley <rob.woolley@windriver.com>"

DISTRO_FEATURES ?= "${DISTRO_FEATURES_DEFAULT} ${OEROS_DEFAULT_DISTRO_FEATURES}"

DISTRO_FEATURES:append = " virtualization"
DISTRO_FEATURES:append = " wayland opengl vulkan polkit"
DISTRO_FEATURES:append = " opencl"
DISTRO_FEATURES:append = " pam"

DISTRO_EXTRA_RDEPENDS += "${OEROS_DEFAULT_EXTRA_RDEPENDS}"
DISTRO_EXTRA_RRECOMMENDS += "${OEROS_DEFAULT_EXTRA_RRECOMMENDS}"

include ${LAYERDIR}/conf/distro/include/packageconfig.inc
include ${LAYERDIR}/conf/distro/include/zenoh.inc
```

## conf/layer.conf
```bitbake
# Copyright (c) 2026 Wind River Systems, Inc.

# We have a conf and classes directory, add to BBPATH
BBPATH =. "${LAYERDIR}:"

# We have recipes-* directories, add to BBFILES
BBFILES += "${LAYERDIR}/recipes-*/*/*.bb \
            ${LAYERDIR}/recipes-*/*/*.bbappend"

BBFILE_COLLECTIONS += "oeros"
BBFILE_PATTERN_oeros = "^${LAYERDIR}/"
BBFILE_PRIORITY_oeros = "5"

LAYERSERIES_COMPAT_oeros = "wrynose"

# This should only be incremented on significant changes that will
# cause compatibility issues with other layers
LAYERVERSION_oeros = "3"

LAYERDEPENDS_oeros = "core openembedded-layer meta-python virtualization-layer"
```
